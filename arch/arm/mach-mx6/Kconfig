## arch/arm/mach-mx6/Kconfig
```kconfig
if ARCH_MX6

config ARCH_MX6Q
	bool
	select USB_ARCH_HAS_EHCI
	select ARCH_MXC_IOMUX_V3
	select ARCH_MXC_AUDMUX_V2
	select ARCH_SUPPORTS_MSI
	select ARM_GIC
	select ARCH_HAS_CPUFREQ
	select OC_ETM
	select IMX_HAVE_PLATFORM_IMX_UART
	select IMX_HAVE_PLATFORM_FEC
	select IMX_HAVE_PLATFORM_IMX_ANATOP_THERMAL
	select IMX_HAVE_PLATFORM_IMX_IPUV3
	select IMX_HAVE_PLATFORM_MXC_PWM
	select IMX_HAVE_PLATFORM_LDB
	select IMX_HAVE_PLATFORM_IMX_SPDIF
	select IMX_HAVE_PLATFORM_IMX_VDOA

config FORCE_MAX_ZONEORDER
    int "MAX_ORDER"
    default "13"

config	SOC_IMX6Q
	bool

config	SOC_IMX6SL
	bool

config MACH_MX6Q_ARM2
	bool "Support i.MX 6Quad Armadillo2 platform"
	select ARCH_MX6Q
	select SOC_IMX6Q
	select IMX_HAVE_PLATFORM_IMX_UART
	select IMX_HAVE_PLATFORM_DMA
	select IMX_HAVE_PLATFORM_FEC
	select IMX_HAVE_PLATFORM_GPMI_NFC
	select IMX_HAVE_PLATFORM_SDHCI_ESDHC_IMX
	select IMX_HAVE_PLATFORM_SPI_IMX
	select IMX_HAVE_PLATFORM_IMX_I2C
	select IMX_HAVE_PLATFORM_VIV_GPU
	select IMX_HAVE_PLATFORM_IMX_VPU
	select IMX_HAVE_PLATFORM_IMX_DVFS
	select IMX_HAVE_PLATFORM_IMX_ESAI
	select IMX_HAVE_PLATFORM_IMX_SSI
	select IMX_HAVE_PLATFORM_IMX_ANATOP_THERMAL
	select IMX_HAVE_PLATFORM_FSL_USB2_UDC
	select IMX_HAVE_PLATFORM_MXC_EHCI
	select IMX_HAVE_PLATFORM_FSL_OTG
	select IMX_HAVE_PLATFORM_FSL_USB_WAKEUP
	select IMX_HAVE_PLATFORM_AHCI
	select IMX_HAVE_PLATFORM_IMX_OCOTP
	select IMX_HAVE_PLATFORM_IMX_VIIM
	select IMX_HAVE_PLATFORM_IMX2_WDT
	select IMX_HAVE_PLATFORM_IMX_SNVS_RTC
	select IMX_HAVE_PLATFORM_IMX_PM
	select IMX_HAVE_PLATFORM_MXC_HDMI
	select IMX_HAVE_PLATFORM_IMX_ASRC
	select IMX_HAVE_PLATFORM_IMX_SPDIF
	select IMX_HAVE_PLATFORM_IMX_MIPI_DSI
	select IMX_HAVE_PLATFORM_FLEXCAN
	select IMX_HAVE_PLATFORM_IMX_MIPI_CSI2
	select IMX_HAVE_PLATFORM_PERFMON
	select IMX_HAVE_PLATFORM_MXC_MLB
	select IMX_HAVE_PLATFORM_IMX_EPDC
	select IMX_HAVE_PLATFORM_IMX_ELCDIF
	select IMX_HAVE_PLATFORM_IMX_PXP
	select IMX_HAVE_PLATFORM_IMX_PCIE
	select IMX_HAVE_PLATFORM_IMX_CAAM
	help
	  Include support for i.MX 6Quad Armadillo2 platform. This includes specific
	  configurations for the board and its peripherals.

config MACH_MX6SL_ARM2
	bool "Support i.MX 6SoloLite Armadillo2 platform"
	select ARCH_MX6Q
	select SOC_IMX6SL
	select IMX_HAVE_PLATFORM_IMX_UART
	select IMX_HAVE_PLATFORM_DMA
	select IMX_HAVE_PLATFORM_FEC
	select IMX_HAVE_PLATFORM_SDHCI_ESDHC_IMX
	select IMX_HAVE_PLATFORM_SPI_IMX
	select IMX_HAVE_PLATFORM_IMX_I2C
	select IMX_HAVE_PLATFORM_VIV_GPU
	select IMX_HAVE_PLATFORM_IMX_DVFS
	select IMX_HAVE_PLATFORM_IMX_SSI
	select IMX_HAVE_PLATFORM_IMX_ANATOP_THERMAL
	select IMX_HAVE_PLATFORM_FSL_USB2_UDC
	select IMX_HAVE_PLATFORM_MXC_EHCI
	select IMX_HAVE_PLATFORM_FSL_OTG
	select IMX_HAVE_PLATFORM_FSL_USB_WAKEUP
	select IMX_HAVE_PLATFORM_AHCI
	select IMX_HAVE_PLATFORM_IMX_OCOTP
	select IMX_HAVE_PLATFORM_IMX_VIIM
	select IMX_HAVE_PLATFORM_IMX2_WDT
	select IMX_HAVE_PLATFORM_IMX_SNVS_RTC
	select IMX_HAVE_PLATFORM_IMX_PM
	select IMX_HAVE_PLATFORM_IMX_SPDIF
	select IMX_HAVE_PLATFORM_PERFMON
	select IMX_HAVE_PLATFORM_IMX_EPDC
	select IMX_HAVE_PLATFORM_IMX_SPDC
	select IMX_HAVE_PLATFORM_IMX_PXP
	select IMX_HAVE_PLATFORM_IMX_KEYPAD
	select IMX_HAVE_PLATFORM_IMX_DCP
	select IMX_HAVE_PLATFORM_RANDOM_RNGC
	select ARCH_HAS_RNGC
	help
	  Include support for i.MX 6Sololite Armadillo2 platform. This includes specific
	  configurations for the board and its peripherals.

config MACH_MX6SL_EVK
	bool "Support i.MX 6SoloLite EVK platform"
	select ARCH_MX6Q
	select SOC_IMX6SL
	select IMX_HAVE_PLATFORM_IMX_UART
	select IMX_HAVE_PLATFORM_DMA
	select IMX_HAVE_PLATFORM_FEC
	select IMX_HAVE_PLATFORM_SDHCI_ESDHC_IMX
	select IMX_HAVE_PLATFORM_SPI_IMX
	select IMX_HAVE_PLATFORM_IMX_I2C
	select IMX_HAVE_PLATFORM_VIV_GPU
	select IMX_HAVE_PLATFORM_IMX_DVFS
	select IMX_HAVE_PLATFORM_IMX_SSI
	select IMX_HAVE_PLATFORM_IMX_ANATOP_THERMAL
	select IMX_HAVE_PLATFORM_FSL_USB2_UDC
	select IMX_HAVE_PLATFORM_MXC_EHCI
	select IMX_HAVE_PLATFORM_FSL_OTG
	select IMX_HAVE_PLATFORM_FSL_USB_WAKEUP
	select IMX_HAVE_PLATFORM_AHCI
	select IMX_HAVE_PLATFORM_IMX_OCOTP
	select IMX_HAVE_PLATFORM_IMX_VIIM
	select IMX_HAVE_PLATFORM_IMX2_WDT
	select IMX_HAVE_PLATFORM_IMX_SNVS_RTC
	select IMX_HAVE_PLATFORM_IMX_PM
	select IMX_HAVE_PLATFORM_IMX_SPDIF
	select IMX_HAVE_PLATFORM_PERFMON
	select IMX_HAVE_PLATFORM_IMX_EPDC
	select IMX_HAVE_PLATFORM_IMX_SPDC
	select IMX_HAVE_PLATFORM_IMX_PXP
	select IMX_HAVE_PLATFORM_IMX_FSL_CSI
	select IMX_HAVE_PLATFORM_IMX_KEYPAD
	select IMX_HAVE_PLATFORM_IMX_DCP
	select IMX_HAVE_PLATFORM_RANDOM_RNGC
	select ARCH_HAS_RNGC
	help
	  Include support for i.MX 6Sololite EVK platform. This includes specific
	  configurations for the board and its peripherals.

config MACH_MX6Q_SABRELITE
	bool "Support i.MX 6Quad SABRE Lite platform"
	select ARCH_MX6Q
	select SOC_IMX6Q
	select IMX_HAVE_PLATFORM_IMX_UART
	select IMX_HAVE_PLATFORM_DMA
	select IMX_HAVE_PLATFORM_FEC
	select IMX_HAVE_PLATFORM_GPMI_NFC
	select IMX_HAVE_PLATFORM_SDHCI_ESDHC_IMX
	select IMX_HAVE_PLATFORM_SPI_IMX
	select IMX_HAVE_PLATFORM_IMX_I2C
	select IMX_HAVE_PLATFORM_VIV_GPU
	select IMX_HAVE_PLATFORM_IMX_VPU
	select IMX_HAVE_PLATFORM_IMX_SSI
	select IMX_HAVE_PLATFORM_IMX_ANATOP_THERMAL
	select IMX_HAVE_PLATFORM_FSL_USB2_UDC
	select IMX_HAVE_PLATFORM_MXC_EHCI
	select IMX_HAVE_PLATFORM_FSL_OTG
	select IMX_HAVE_PLATFORM_FSL_USB_WAKEUP
	select IMX_HAVE_PLATFORM_AHCI
	select IMX_HAVE_PLATFORM_IMX_OCOTP
	select IMX_HAVE_PLATFORM_IMX_VIIM
	select IMX_HAVE_PLATFORM_IMX2_WDT
	select IMX_HAVE_PLATFORM_IMX_SNVS_RTC
	select IMX_HAVE_PLATFORM_IMX_PM
	select IMX_HAVE_PLATFORM_MXC_HDMI
	select IMX_HAVE_PLATFORM_IMX_ASRC
	select IMX_HAVE_PLATFORM_FLEXCAN
	select IMX_HAVE_PLATFORM_IMX_CAAM
	help
	  Include support for i.MX 6Quad SABRE Lite platform. This includes specific
	  configurations for the board and its peripherals.

config MACH_MX6Q_SABRESD
	bool "Support i.MX 6Quad SABRESD platform"
	select ARCH_MX6Q
	select SOC_IMX6Q
	select IMX_HAVE_PLATFORM_IMX_UART
	select IMX_HAVE_PLATFORM_DMA
	select IMX_HAVE_PLATFORM_FEC
	select IMX_HAVE_PLATFORM_GPMI_NFC
	select IMX_HAVE_PLATFORM_SDHCI_ESDHC_IMX
	select IMX_HAVE_PLATFORM_SPI_IMX
	select IMX_HAVE_PLATFORM_IMX_I2C
	select IMX_HAVE_PLATFORM_VIV_GPU
	select IMX_HAVE_PLATFORM_IMX_VPU
	select IMX_HAVE_PLATFORM_IMX_SSI
	select IMX_HAVE_PLATFORM_IMX_ANATOP_THERMAL
	select IMX_HAVE_PLATFORM_FSL_USB2_UDC
	select IMX_HAVE_PLATFORM_MXC_EHCI
	select IMX_HAVE_PLATFORM_FSL_OTG
	select IMX_HAVE_PLATFORM_FSL_USB_WAKEUP
	select IMX_HAVE_PLATFORM_AHCI
	select IMX_HAVE_PLATFORM_IMX_OCOTP
	select IMX_HAVE_PLATFORM_IMX_VIIM
	select IMX_HAVE_PLATFORM_IMX2_WDT
	select IMX_HAVE_PLATFORM_IMX_SNVS_RTC
	select IMX_HAVE_PLATFORM_IMX_PM
	select IMX_HAVE_PLATFORM_MXC_HDMI
	select IMX_HAVE_PLATFORM_IMX_ASRC
	select IMX_HAVE_PLATFORM_FLEXCAN
	select IMX_HAVE_PLATFORM_IMX_PCIE
	select IMX_HAVE_PLATFORM_IMX_CAAM
	help
	  Include support for i.MX 6Quad SABRE SD platform. This includes specific
	  configurations for the board and its peripherals.

config MACH_MX6Q_SABREAUTO
	bool "Support i.MX 6Quad SABRE Auto platform"
	select ARCH_MX6Q
	select SOC_IMX6Q
	select IMX_HAVE_PLATFORM_IMX_UART
	select IMX_HAVE_PLATFORM_DMA
	select IMX_HAVE_PLATFORM_FEC
	select IMX_HAVE_PLATFORM_GPMI_NFC
	select IMX_HAVE_PLATFORM_SDHCI_ESDHC_IMX
	select IMX_HAVE_PLATFORM_SPI_IMX
	select IMX_HAVE_PLATFORM_IMX_I2C
	select IMX_HAVE_PLATFORM_VIV_GPU
	select IMX_HAVE_PLATFORM_IMX_VPU
	select IMX_HAVE_PLATFORM_IMX_DVFS
	select IMX_HAVE_PLATFORM_IMX_ESAI
	select IMX_HAVE_PLATFORM_IMX_ANATOP_THERMAL
	select IMX_HAVE_PLATFORM_FSL_USB2_UDC
	select IMX_HAVE_PLATFORM_MXC_EHCI
	select IMX_HAVE_PLATFORM_FSL_OTG
	select IMX_HAVE_PLATFORM_FSL_USB_WAKEUP
	select IMX_HAVE_PLATFORM_AHCI
	select IMX_HAVE_PLATFORM_IMX_OCOTP
	select IMX_HAVE_PLATFORM_IMX_VIIM
	select IMX_HAVE_PLATFORM_IMX2_WDT
	select IMX_HAVE_PLATFORM_IMX_SNVS_RTC
	select IMX_HAVE_PLATFORM_IMX_PM
	select IMX_HAVE_PLATFORM_MXC_HDMI
	select IMX_HAVE_PLATFORM_IMX_ASRC
	select IMX_HAVE_PLATFORM_IMX_SPDIF
	select IMX_HAVE_PLATFORM_IMX_MIPI_DSI
	select IMX_HAVE_PLATFORM_FLEXCAN
	select IMX_HAVE_PLATFORM_IMX_MIPI_CSI2
	select IMX_HAVE_PLATFORM_IMX_PCIE
	select IMX_HAVE_PLATFORM_IMX_CAAM
	help
	  Include support for i.MX 6Quad SABRE Auto platform. This includes specific
	  configurations for the board and its peripherals.

config MACH_MX6Q_HDMIDONGLE
	bool "Support i.MX 6Quad HDMIDONGLE platform"
	select ARCH_MX6Q
	select SOC_IMX6Q
	select IMX_HAVE_PLATFORM_IMX_UART
	select IMX_HAVE_PLATFORM_DMA
	select IMX_HAVE_PLATFORM_GPMI_NFC
	select IMX_HAVE_PLATFORM_SDHCI_ESDHC_IMX
	select IMX_HAVE_PLATFORM_SPI_IMX
	select IMX_HAVE_PLATFORM_IMX_I2C
	select IMX_HAVE_PLATFORM_VIV_GPU
	select IMX_HAVE_PLATFORM_IMX_VPU
	select IMX_HAVE_PLATFORM_IMX_DVFS
	select IMX_HAVE_PLATFORM_IMX_ANATOP_THERMAL
	select IMX_HAVE_PLATFORM_FSL_USB2_UDC
	select IMX_HAVE_PLATFORM_MXC_EHCI
	select IMX_HAVE_PLATFORM_FSL_OTG
	select IMX_HAVE_PLATFORM_FSL_USB_WAKEUP
	select IMX_HAVE_PLATFORM_AHCI
	select IMX_HAVE_PLATFORM_IMX_OCOTP
	select IMX_HAVE_PLATFORM_IMX_VIIM
	select IMX_HAVE_PLATFORM_IMX2_WDT
	select IMX_HAVE_PLATFORM_IMX_SNVS_RTC
	select IMX_HAVE_PLATFORM_IMX_PM
	select IMX_HAVE_PLATFORM_MXC_HDMI
	select IMX_HAVE_PLATFORM_IMX_PCIE
	help
	  Include support for i.MX 6Quad HDMI Dongle platform. This includes specific
	  configurations for the board and its peripherals.


config SOM_SECO
	bool

config MACH_MX6_SECO_Q7
        bool "Support i.MX 6 Quad/DualSolo/DualLite SECO Q7 platform"
	select ARCH_MX6Q
	select SOC_IMX6Q
	select SOM_SECO
	select IMX_HAVE_PLATFORM_IMX_UART
	select IMX_HAVE_PLATFORM_DMA
	select IMX_HAVE_PLATFORM_FEC
	select IMX_HAVE_PLATFORM_GPMI_NFC
	select IMX_HAVE_PLATFORM_SDHCI_ESDHC_IMX
	select IMX_HAVE_PLATFORM_SPI_IMX
	select IMX_HAVE_PLATFORM_IMX_I2C
	select IMX_HAVE_PLATFORM_VIV_GPU
	select IMX_HAVE_PLATFORM_IMX_VPU
	select IMX_HAVE_PLATFORM_IMX_DVFS
	select IMX_HAVE_PLATFORM_IMX_ESAI
	select IMX_HAVE_PLATFORM_IMX_ANATOP_THERMAL
	select IMX_HAVE_PLATFORM_FSL_USB2_UDC
	select IMX_HAVE_PLATFORM_MXC_EHCI
	select IMX_HAVE_PLATFORM_FSL_OTG
	select IMX_HAVE_PLATFORM_FSL_USB_WAKEUP
	select IMX_HAVE_PLATFORM_AHCI
	select IMX_HAVE_PLATFORM_IMX_OCOTP
	select IMX_HAVE_PLATFORM_IMX_VIIM
	select IMX_HAVE_PLATFORM_IMX2_WDT
	select IMX_HAVE_PLATFORM_IMX_SNVS_RTC
	select IMX_HAVE_PLATFORM_IMX_PM
	select IMX_HAVE_PLATFORM_MXC_HDMI
	select IMX_HAVE_PLATFORM_IMX_ASRC
	select IMX_HAVE_PLATFORM_IMX_SPDIF
	select IMX_HAVE_PLATFORM_IMX_MIPI_DSI
	select IMX_HAVE_PLATFORM_FLEXCAN
	select IMX_HAVE_PLATFORM_IMX_MIPI_CSI2
	select IMX_HAVE_PLATFORM_IMX_PCIE
	select IMX_HAVE_PLATFORM_IMX_CAAM
        help
          Include support for i.MX6 Solo/DualLite SECO Q7 platform. This includes specific
          configurations for the board and its peripherals.

config MACH_MX6_SECO_UQ7
        bool "Support i.MX 6 Quad/DualSolo/DualLite SECO uQ7 platform"
	select ARCH_MX6Q
	select SOC_IMX6Q
	select SOM_SECO
	select IMX_HAVE_PLATFORM_IMX_UART
	select IMX_HAVE_PLATFORM_DMA
	select IMX_HAVE_PLATFORM_FEC
	select IMX_HAVE_PLATFORM_GPMI_NFC
	select IMX_HAVE_PLATFORM_SDHCI_ESDHC_IMX
	select IMX_HAVE_PLATFORM_SPI_IMX
	select IMX_HAVE_PLATFORM_IMX_I2C
	select IMX_HAVE_PLATFORM_VIV_GPU
	select IMX_HAVE_PLATFORM_IMX_VPU
	select IMX_HAVE_PLATFORM_IMX_DVFS
	select IMX_HAVE_PLATFORM_IMX_ESAI
	select IMX_HAVE_PLATFORM_IMX_ANATOP_THERMAL
	select IMX_HAVE_PLATFORM_FSL_USB2_UDC
	select IMX_HAVE_PLATFORM_MXC_EHCI
	select IMX_HAVE_PLATFORM_FSL_OTG
	select IMX_HAVE_PLATFORM_FSL_USB_WAKEUP
	select IMX_HAVE_PLATFORM_AHCI
	select IMX_HAVE_PLATFORM_IMX_OCOTP
	select IMX_HAVE_PLATFORM_IMX_VIIM
	select IMX_HAVE_PLATFORM_IMX2_WDT
	select IMX_HAVE_PLATFORM_IMX_SNVS_RTC
	select IMX_HAVE_PLATFORM_IMX_PM
	select IMX_HAVE_PLATFORM_MXC_HDMI
	select IMX_HAVE_PLATFORM_IMX_ASRC
	select IMX_HAVE_PLATFORM_IMX_SPDIF
	select IMX_HAVE_PLATFORM_IMX_MIPI_DSI
	select IMX_HAVE_PLATFORM_FLEXCAN
	select IMX_HAVE_PLATFORM_IMX_MIPI_CSI2
	select IMX_HAVE_PLATFORM_IMX_PCIE
	select IMX_HAVE_PLATFORM_IMX_CAAM
        help
          Include support for i.MX6 Solo/DualLite SECO Q7 platform. This includes specific
          configurations for the board and its peripherals.

config MACH_MX6_SECO_uSBC
        bool "Support i.MX 6 Quad/DualSolo/DualLite SECO uSBC platform"
        select ARCH_MX6Q
        select SOC_IMX6Q
        select SOM_SECO
        select IMX_HAVE_PLATFORM_IMX_UART
        select IMX_HAVE_PLATFORM_DMA
        select IMX_HAVE_PLATFORM_FEC
        select IMX_HAVE_PLATFORM_GPMI_NFC
        select IMX_HAVE_PLATFORM_SDHCI_ESDHC_IMX
        select IMX_HAVE_PLATFORM_SPI_IMX
        select IMX_HAVE_PLATFORM_IMX_I2C
        select IMX_HAVE_PLATFORM_VIV_GPU
        select IMX_HAVE_PLATFORM_IMX_VPU
        select IMX_HAVE_PLATFORM_IMX_DVFS
        select IMX_HAVE_PLATFORM_IMX_ESAI
        select IMX_HAVE_PLATFORM_IMX_ANATOP_THERMAL
        select IMX_HAVE_PLATFORM_FSL_USB2_UDC
        select IMX_HAVE_PLATFORM_MXC_EHCI
        select IMX_HAVE_PLATFORM_FSL_OTG
        select IMX_HAVE_PLATFORM_FSL_USB_WAKEUP
        select IMX_HAVE_PLATFORM_AHCI
        select IMX_HAVE_PLATFORM_IMX_OCOTP
        select IMX_HAVE_PLATFORM_IMX_VIIM
        select IMX_HAVE_PLATFORM_IMX2_WDT
        select IMX_HAVE_PLATFORM_IMX_SNVS_RTC
        select IMX_HAVE_PLATFORM_IMX_PM
        select IMX_HAVE_PLATFORM_MXC_HDMI
        select IMX_HAVE_PLATFORM_IMX_ASRC
        select IMX_HAVE_PLATFORM_IMX_SPDIF
        select IMX_HAVE_PLATFORM_IMX_MIPI_DSI
        select IMX_HAVE_PLATFORM_FLEXCAN
        select IMX_HAVE_PLATFORM_IMX_MIPI_CSI2
        select IMX_HAVE_PLATFORM_IMX_PCIE
        select IMX_HAVE_PLATFORM_IMX_CAAM
        help
          Include support for i.MX6 Solo/DualLite SECO Micro Single Board  platform. This includes specific
          configurations for the board and its peripherals.

config MACH_MX6_SECO_A62
        bool "Support i.MX 6 Quad/Dual Solo/DualLite SECO A62 platform"
        select ARCH_MX6Q
        select SOC_IMX6Q
        select SOM_SECO
        select IMX_HAVE_PLATFORM_IMX_UART
        select IMX_HAVE_PLATFORM_DMA
        select IMX_HAVE_PLATFORM_FEC
        select IMX_HAVE_PLATFORM_GPMI_NFC
        select IMX_HAVE_PLATFORM_SDHCI_ESDHC_IMX
        select IMX_HAVE_PLATFORM_SPI_IMX
        select IMX_HAVE_PLATFORM_IMX_I2C
        select IMX_HAVE_PLATFORM_VIV_GPU
        select IMX_HAVE_PLATFORM_IMX_VPU
        select IMX_HAVE_PLATFORM_IMX_DVFS
        select IMX_HAVE_PLATFORM_IMX_ESAI
        select IMX_HAVE_PLATFORM_IMX_ANATOP_THERMAL
        select IMX_HAVE_PLATFORM_FSL_USB2_UDC
        select IMX_HAVE_PLATFORM_MXC_EHCI
        select IMX_HAVE_PLATFORM_FSL_OTG
        select IMX_HAVE_PLATFORM_FSL_USB_WAKEUP
        select IMX_HAVE_PLATFORM_AHCI
        select IMX_HAVE_PLATFORM_IMX_OCOTP
        select IMX_HAVE_PLATFORM_IMX_VIIM
        select IMX_HAVE_PLATFORM_IMX2_WDT
        select IMX_HAVE_PLATFORM_IMX_SNVS_RTC
        select IMX_HAVE_PLATFORM_IMX_PM
        select IMX_HAVE_PLATFORM_MXC_HDMI
        select IMX_HAVE_PLATFORM_IMX_ASRC
        select IMX_HAVE_PLATFORM_IMX_SPDIF
        select IMX_HAVE_PLATFORM_IMX_MIPI_DSI
        select IMX_HAVE_PLATFORM_FLEXCAN
        select IMX_HAVE_PLATFORM_IMX_MIPI_CSI2
        select IMX_HAVE_PLATFORM_IMX_PCIE
        select IMX_HAVE_PLATFORM_IMX_CAAM
        help
          Include support for i.MX6 Quad/Dual Solo/DualLite SECO A62 Board platform. This includes specific
          configurations for the board and its peripherals.

comment "MX6 Options:"

####### SECO MENU FEATURES #######

menu "Seco Qseven Option"
        depends on MACH_MX6_SECO_Q7 || MACH_MX6_SECO_UQ7 || MACH_MX6_SECO_uSBC

config Q7_SATA_AHCI
        bool "Q7 SATA support"
	select SATA_AHCI
	select SATA_AHCI_PLATFORM
        help
            This option enables support for Platform AHCI Serial ATA controllers.
            on seco Q7.

            If unsure, say Y.

config Q7_PCIE
        bool "Q7 PCIE support"
	select IMX_PCIE
        help
            This option enables support for PCIE bus and peripheral
            on seco Q7.

            If unsure, say Y.

config Q7_ATH9KL
        bool "Q7 wifi card Atheros ATH9KL"
        depends on Q7_PCIE
	select PCI
	select WLAN
	select ATH9K
	select MAC80211
	select ATH9K_PCI
	select ATH_COMMON
	select NETDEVICES

        help
            say Y here if you have a Seco Q7 board and want to use Atheros ATH9K WiFi chip.

            If unsure, say Y.
config Q7_RTC_BRIDGE
	bool "Q7 RTC bridge"
	depends on ARCH_MXC && RTC_CLASS && SPI_MASTER 
	select RTC_DRV_PCF2123
	select RTC_DRV_SNVS
	select RTC_DRV_BRIDGE  

	help
	   This is a virtual driver that connects PCF2123 driver and RTC SNVS driver together
	   When you write a new time this driver calls PCF2123 write function and SNVS write function.
	   When you read a new time you read time from Internal iMX6 SNVS RTC timer. 
		
config RTC_EXT
	bool "External RTC"
	depends on ARCH_MXC && RTC_CLASS && SPI_MASTER && RTC_DRV_PCF2123

	help
	   This is an option for connect device PCF2123, mount on the carrier board, to Qseven SPI Bus
	   means CS0 signal 
		
config Q7_MTD_M25P80
        bool "Q7 M25P80 spi flash device"
        depends on SPI_MASTER && GENERIC_HARDIRQS
	select MTD_M25P80
        help
            say Y here if you have a Seco Q7 board and want to access flash SPI device.

            If unsure, say N.

choice

	prompt "AC97 codecs:"
        default Q7_SND_SOC_IMX_AC97_VT1613 

config Q7_SND_SOC_IMX_AC97_VT1613
        bool "Q7 'AC97 AUDIO CODEC VT1613"
        depends on SND_IMX_SOC && SOUND && SND_SOC
	select SND_SOC_IMX_AC97_VT1613
        help
            say Y here if you have a Seco Q7 board and want to use audio codec 'AC97.

            If unsure, say Y.

config Q7_SND_SOC_IMX_AC97_GENERIC
        bool "Q7 'AC97 GENERIC AUDIO CODEC"
        depends on SND_IMX_SOC && SOUND && SND_SOC
        select SND_SOC_IMX_AC97_GENERIC
        help
            say Y here if you have a Seco Q7 board and want to use a generic ac97 audio codec.

            If unsure, say Y.

endchoice

choice
	prompt "TSC based touchscreen:"
	default Q7_TOUCHSCREEN_NONE

config Q7_TOUCHSCREEN_NONE
	bool "None"
	help
	    No TouchScreen used

config Q7_TOUCHSCREEN_TSC2006
        bool "TSC2006 based touchscreen"
        depends on SPI_MASTER && GENERIC_HARDIRQS
	select TOUCHSCREEN_TSC2006
        help
            say Y here if you have a TSC2006 based Touchscreen.

            If unsure, say N.

config Q7_TOUCHSCREEN_TSC2004
        bool "TSC2004 based touchscreen"
        depends on I2C
	select TOUCHSCREEN_TSC2004
        help
            say Y here if you have a TSC2004 based Touchscreen.

            If unsure, say N.

config Q7_TOUCHSCREEN_ATMEL_MXT
        bool "Atmel MXT1188 based touchscreen"
        depends on I2C
	select TOUCHSCREEN_ATMEL_MXT
        help
            say Y here if you have a Atmel MXT1188 based Touchscreen. - (it is not a CrossPlatform Component)

            If unsure, say N.

endchoice

menuconfig TOUCHSCREEN_SITRONIX_ST1232_SUPPORT
	bool "touchscreen st1232"

if TOUCHSCREEN_SITRONIX_ST1232_SUPPORT

config TOUCHSCREEN_SITRONIX_ST1232
        bool "Sitronix st1332 based touchscreen (uSBC board)"
        depends on I2C && TOUCHSCREEN_SITRONIX_ST1232_SUPPORT
        select TOUCHSCREEN_ST1232
        select USBC_DEBUG_UART5
        help
            say Y here if you have a Sitronix ST1332 based Touchscreen. - ( for USBC board )

            If unsure, say N.

config TOUCHSCREEN_SITRONIX_ST1232_A62
        bool "Sitronix st1332 based touchscreen (A62 board)"
        depends on I2C && TOUCHSCREEN_SITRONIX_ST1232_SUPPORT
        select TOUCHSCREEN_ST1232
        help
            say Y here if you have a Sitronix ST1332 based Touchscreen. - ( for A62 board )

            If unsure, say N.

endif

config Q7_ECONTROLLER
        bool "Seco Comunication System with the Embedded Controller"
        depends on I2C
        select ECONTROLLER
        help
            Say Y here if you want to use the Seco Halt System with the Embedded Controller.

            If usure, say Y.
           

choice
	prompt "CLPD Implementations"
	default Q7_CPLD_NONE

config Q7_CPLD_NONE
	bool "None"
	help
	   Select this if you don't want to use any CPLD implementation


config Q7_GPIO_EXPANDER
	bool "Seco CPLD GPIO x8 I/O expander"
	select SECO_GPIO_EXPANDER
        help
            Select this  if you want to use the Seco CPLD GPIO x8 I/O expander.

            If usure, don't select this.


config Q7_W83627DHG_LPC
	bool "Winbond w83627dhg with LPC interface"
	select SECO_W83627DHG_LPC
	select SERIAL_8250
	select SERIAL_8250_PCI 
	help
	  Select this if you want to use the Seco Winbond w83627dhg with LPC interface.

              If unsure, don't select this.

	 
config Q7_XR28V382_LPC
	bool "Exar xr28v382 with LPC interface"
	select SECO_XR28V382_LPC
	select SERIAL_8250
	select SERIAL_8250_PCI 
	help
	  Select this if you want to use the Seco Exar xr28v382 with LPC interface.

              If unsure, don't select this.
endchoice

config Q7_RS485
	bool "Use UART of the Winbond as RS485"
	depends on Q7_W83627DHG_LPC && SERIAL_8250
	help 
	  Select this if you want to use the Seco Winbond UART0 as RS485.

              If unsure, don't select this.


 
config Q7_CAM
	bool "CAM OV5640 module"
	select MXC_CAMERA_OV5640_MIPI
	help
	  Select this if you want to use the CAM OV5640 with Q7 module


config Q7_PMIC_PFUZE100
        bool "Freescale PMIC PFuze100"
        depends on I2C
	select REGULATOR
	select MFD_PFUZE
	select REGULATOR_PFUZE100
	
        help
            say Y here if you have a PFUZE100 on board (uQ7 only)

            If unsure, say N.


config Q7_PWM2
	bool "Use the PWM2 of the iMX6 as general PWM"
	depends on MACH_MX6_SECO_Q7 || MACH_MX6_SECO_UQ7
	select PWM_IMX6
	help
		say N here if you want to use it as GPIO.

config Q7_PWM3
	bool "Use the PWM3 of the iMX6 as general PWM"
	depends on MACH_MX6_SECO_Q7 || MACH_MX6_SECO_UQ7
	select PWM_IMX6
	help
		say N here if you want to use it as GPIO.


config Q7_CAN
		bool "Select CAN interface (Q7/uQ7 only)"
		
		help
            say Y here if you want to use the CAN interface (UART4 will be lost) if the Q7/uQ7 board.



config Q7_CAN_TERM
		bool "Select CAN Termination Resistance (affect only uSBC - Micro Single Board)"
		depends on MACH_MX6_SECO_uSBC	
		help
		Say Y if you want to use the Termination Resistance


config Q7_CAN_SILENT_MODE
		bool "Use CAN interface in Silent Mode (affect only uSBC - Micro Single Board)"
		depends on MACH_MX6_SECO_uSBC
		help
		Say Y if you want to use the CAN interface in Silent Mode, for the uSBC board.
		
config USBC_DEBUG_UART5
		bool "Use UART5 as Serial Debug (affect only uSBC - Micro Single Board)"
                depends on MACH_MX6_SECO_uSBC
                help
                Say Y if you want to use the UART5 on J5 as Serial Debug Interface, only for the uSBC board.	

menu "Support for Q7 SDIO interface"

comment "SD data lines"
config MMC_8BIT
	bool "Use external SD with 8 data lines"
	help
		Support for SD at 8 bit

if MACH_MX6_SECO_Q7
comment "SD1 Interface for Q7 board:"
config Q7_EMMC_INTERFACE
	bool "Support for on board eMMC memory"
	help
		Support for on board eMMC memory

config Q7_SD1_INTERFACE
	bool "Support for onboard uSD card"
	help
		Support for onboard uSD card

config Q7_SD2_INTERFACE
	bool "Support for external SD card on carrier board"
	help
		Support for external SD card on carrier board

endif


if MACH_MX6_SECO_UQ7
comment "SD Interface for uQ7 board:"
config UQ7_SD_INTERFACE
	bool "Support for external SD card on carrier board"
	help
		Support for external SD card on carrier board

config UQ7_EMMC_INTERFACE
	bool "Support for on board eMMC memory"
	help
		Support for on board eMMC memory
endif

if MACH_MX6_SECO_uSBC
comment "eMMC Interface for uSBC board:"

config uSBC_EMMC_INTERFACE
        bool "Support for on board eMMC memory"
        help
              Support for on board eMMC memory
endif

if MACH_MX6_SECO_A62
comment "eMMC and uSD interfaces for A62 board:"

config A62_EMMC_INTERFACE
        bool "Support for on board eMMC memory"
        help
              Support for on board eMMC memory
	
config A62_USD_INTERFACE
        bool "Support for on board uSD memory"
        help
              Support for on board uSD memory
endif
	
endmenu

menuconfig A62_PORTS_CONFIG 
	
	bool "A62 ports configuration"
	help
	"Pinmuxing configuration for J8 connector"

if A62_PORTS_CONFIG
################# PORT 1 #####################
choice
        prompt "Port 1 Configuration:"
        default A62_PORT_1_CONF_1

config A62_PORT_1_CONF_1
	bool 	"Configuring Port 1 as generic GPIO"
	help
		"Configuring Port 1 as generic GPIO"
endchoice

################# PORT 2 #####################
choice
        prompt "Port 2 Configuration:"
        default A62_PORT_2_CONF_2

config A62_PORT_2_CONF_1
        bool    "Configuring Port 2 as Bus Spi 2"
        help
                "Configuring Port 2 as Bus Spi 2"

config A62_PORT_2_CONF_2
        bool    "Configuring Port 2 as generic GPIO"
        help
                "Configuring Port 2 as generic GPIO"
endchoice
################# PORT 3 #####################
choice
        prompt "Port 3 Configuration:"
        default A62_PORT_3_CONF_2

config A62_PORT_3_CONF_1
        bool    "Configuring Port 3 as Bus CAN"
        help
                "Configuring Port 3 as Bus CAN"

config A62_PORT_3_CONF_2
        bool    "Configuring Port 3 as generic GPIO"
        help
                "Configuring Port 3 as generic GPIO"
endchoice
################# PORT 4 #####################
choice
        prompt "Port 4 Configuration:"
        default A62_PORT_4_CONF_2

config A62_PORT_4_CONF_1
        bool    "Configuring Port 4 as UART4"
        help
                "Configuring Port 4 as UART4"

config A62_PORT_4_CONF_2
        bool    "Configuring Port 4 as generic GPIO"
        help
                "Configuring Port 4 as generic GPIO"
endchoice
################# PORT 5 #####################
choice
        prompt "Port 5 Configuration:"
        default A62_PORT_5_CONF_3

config A62_PORT_5_CONF_1
        bool    "Configuring Port 5 as SPDIF"
        help
                "Configuring Port 5 as SPDIF"

config A62_PORT_5_CONF_2
        bool    "Configuring Port 5 as I2C_1"
        help
                "Configuring Port 5 as I2C_1"

config A62_PORT_5_CONF_3
        bool    "Configuring Port 5 as generic GPIO"
        help
                "Configuring Port 5 as generic GPIO"
endchoice
################# PORT 6 #####################
choice
        prompt "Port 6 Configuration:"
        default A62_PORT_6_CONF_3

config A62_PORT_6_CONF_1
        bool    "Configuring Port 6 as SDIO"
        help
                "Configuring Port 6 as SDIO"

config A62_PORT_6_CONF_2
        bool    "Configuring Port 6 as PWM"
	select PWM_IMX6
        help
                "Configuring Port 6 as PWM"

config A62_PORT_6_CONF_3
        bool    "Configuring Port 6 as generic GPIO"
        help
                "Configuring Port 6 as generic GPIO"
endchoice
################# PORT 7 #####################
choice
        prompt "Port 7 Configuration:"
        default A62_PORT_7_CONF_2

config A62_PORT_7_CONF_1
        bool    "Configuring Port 7 as I2C_3"
        help
                "Configuring Port 7 as I2C_3"

config A62_PORT_7_CONF_2
        bool    "Configuring Port 7 as gerneric GPIO"
        help
                "Configuring Port 7 as generic GPIO"
endchoice
################# PORT 8 #####################
choice
        prompt "Port 8 Configuration:"
        default A62_PORT_8_CONF_2

config A62_PORT_8_CONF_1
        bool    "Configuring Port 8 as UART1"
        help
                "Configuring Port 8 as UART1"

config A62_PORT_8_CONF_2
        bool    "Configuring Port 8 as gerneric GPIO"
        help
                "Configuring Port 8 as generic GPIO"
endchoice
################# PORT 9 #####################
choice
        prompt "Port 9 Configuration:"
        default A62_PORT_9_CONF_2

config A62_PORT_9_CONF_1
        bool    "Configuring Port 9 as UART5"
        help
                "Configuring Port 9 as UART5"

config A62_PORT_9_CONF_2
        bool    "Configuring Port 9 as gerneric GPIO"
        help
                "Configuring Port 9 as generic GPIO"

endchoice

endif

endmenu

#####################

config IMX_PCIE
	bool "PCI Express support"
	select PCI

config IMX_PCIE_EP_MODE_IN_EP_RC_SYS
	bool "PCI Express EP mode in the IMX6 RC/EP interconnection system"
	depends on IMX_PCIE

config IMX_PCIE_RC_MODE_IN_EP_RC_SYS
	bool "PCI Express RC mode in the IMX6 RC/EP interconnection system"
	depends on IMX_PCIE

config USB_EHCI_ARC_H1
	tristate "USB Host 1 support"
	depends on USB_EHCI_ARC

config USB_FSL_ARC_OTG
	tristate "FSL USB OTG support"

config USB_ID_WAKEUP_ENABLE
	bool "Enable USB ID Pin As System Wakeup Source"
	depends on SOC_IMX6SL
	default n

config MX6_INTER_LDO_BYPASS
	bool "Internal LDO in MX6Q/DL bypass"
	depends on  REGULATOR_PFUZE100 && CPU_FREQ_IMX && ARCH_MX6
	default n
	help
	 This is choosed for bypass internal LDO in MX6. If choose it, internal
	 LDO will replaced by external pmic regulator(e.g. pfuze100), VDDCORE
	 can be adjust automatically adjust by cpu frequency.

config MX6_CLK_FOR_BOOTUI_TRANS
	bool "MX6 clk setting for smooth UI transtion from bootloader to kernel"
	depends on MXC_IPU_V3H
	default n
	help
	 This is choosed to keep enable IPU related clocks and PWM clocks and
	 avoid setting IPU related clocks' parents when initializing clock tree
	 so that bootloader splashimage can transition to kernel smoothly.

config MACH_IMX_BLUETOOTH_RFKILL
       tristate "i.MX Bluetooth rfkill interface support"
       depends on RFKILL
       ---help---
	Say Y to get the standard rfkill interface of Bluetooth

config SDMA_IRAM
	bool "Use Internal RAM for SDMA data structures"
	depends on IMX_SDMA && SOC_IMX6SL
	help
	  SDMA buffer or control structures are stored in the IRAM/OCRAM


endif
```
